## config/west.yml
```yaml
manifest:
  remotes:
    - name: zmkfirmware
      url-base: https://github.com/zmkfirmware
  projects:
    - name: zmk
      remote: zmkfirmware
      revision: main   # <--- HIER 'main' durch einen Release-Tag ersetzen
      import: app/west.yml
  self:
    path: config
    
```
